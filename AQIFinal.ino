#include <Adafruit_GFX.h>
#include <Adafruit_SPFD54124B.h>
#include <Fonts/FreeSerif9pt7b.h>
#include <Fonts/FreeSansBoldOblique24pt7b.h>

#include <SoftwareSerial.h>
#include <Adafruit_Sensor.h>
#include <DHT.h>
#include <MQ135.h>
#include <EEPROM.h>


#define PIN_MQ135 A6

MQ135 mq135_sensor(PIN_MQ135);

#define DHTPIN 2

#define DHTTYPE DHT11
DHT dht(DHTPIN, DHTTYPE);

uint32_t delayMS;
//Create software serial object to communicate with HC-05
//                                                                                                                                                                                                                           SoftwareSerial mySerial(3, 2);  //HC-05 Tx & Rx is connected to Arduino #3 & #2
#define TFT_CS 10
#define TFT_RESET 9

#define BLACK 0x0000
#define BLUE 0x001F
#define RED 0xF800
#define GREEN 0x07E0
#define CYAN 0x07FF
#define MAGENTA 0xF81F
#define YELLOW 0xFFE0
#define WHITE 0xFFFF
#define BUZZER 8

Adafruit_SPFD54124B display(TFT_RESET, TFT_CS);

String value;

#define ledPower 7  //Connect 3 led driver pins of dust sensor to Arduino D2
#define Mqpin A6
#define Pmpin A0

int samplingTime = 280;  // time required to sample signal coming out   of the sensor

int deltaTime = 40;  //

int sleepTime = 9680;

float voMeasured = 0;

float calcVoltage = 0;

float dustDensity = 0;

float temperature = 0;
float humidity = 0;

// const int numReadings = 10;

// int readings[numReadings];      // the readings from the analog input
// int Array[numReadings];
// int total = 0;                  // the running total
// int average;                // the average

int analogdata2;

String rawdata;
int Pmindex;
int COindex;
float Pmthreshold, COthreshold;

const unsigned char myBitmap[] PROGMEM = {
  0x00, 0x00, 0x00, 0x00, 0x00, 0x00, 0x00, 0x00, 0x00, 0x00, 0x00, 0x00, 0x00, 0x00, 0x00, 0x00,
  0x00, 0x00, 0x00, 0x00, 0x00, 0x00, 0x00, 0x00, 0x00, 0x00, 0x00, 0x00, 0x00, 0x00, 0x00, 0x00,
  0x00, 0x00, 0x00, 0x00, 0x00, 0x00, 0x00, 0x00, 0x00, 0x00, 0x00, 0x00, 0x00, 0x00, 0x00, 0x00,
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  0x00, 0x00, 0x00, 0x00, 0x00, 0x00, 0x00, 0x00, 0x00, 0x00, 0x00, 0x00, 0x00, 0x00, 0x00, 0x00
};

SoftwareSerial BTSerial(5, 6);  // RX | TX
void setup() {
  EEPROM.get(0, Pmthreshold);
  EEPROM.get(20, COthreshold);
  // put your setup code here, to run once:
  Serial.begin(9600);
  //Begin serial communication with Arduino and HC-05
  BTSerial.begin(9600);

  display.begin();
  display.setRotation(1);
  unsigned long time;
  time = millis();

  display.fillScreen(WHITE);
  display.fillScreen(BLACK);

  Serial.println(millis() - time);

  // display.fillRect(100, 10, 20, 20, CYAN);

  // display.setTextColor(WHITE);

  // display.setCursor(5, 20);
  // display.setFont(&FreeSerif9pt7b);
  // display.print("Hello World");

  pinMode(Mqpin, INPUT);
  pinMode(Pmpin, INPUT);
  pinMode(ledPower, OUTPUT);
  pinMode(BUZZER, OUTPUT);
  digitalWrite(BUZZER, HIGH);
  delay(100);
  digitalWrite(BUZZER, LOW);
  dht.begin();
}

void loop() {
  // put your main code here, to run repeatedly:
  //display.fillScreen(BLACK);
  // display.display();
  // delay(200);
  display.fillRect(70, 0, 100, 128, BLACK);

  display.setTextColor(WHITE);
  display.setCursor(70,8);
  display.setFont();
  display.print(Pmthreshold);
 // display.print(" ");
  display.setCursor(70,38);
  display.setFont();
  display.print(COthreshold);

  digitalWrite(ledPower, LOW);
  delayMicroseconds(samplingTime);


  analogdata2 = analogRead(Pmpin);


  delayMicroseconds(deltaTime);


  digitalWrite(ledPower, HIGH);  // turn the LED off


  delayMicroseconds(sleepTime);


  temperature = dht.readTemperature();
  humidity = dht.readHumidity();
  // Check if any reads failed and exit early (to try again).
  if (isnan(temperature) || isnan(humidity)) {
    Serial.println(F("Failed to read from DHT sensor!"));
    return;
  }
  float correctedPPM = mq135_sensor.getCorrectedPPM(temperature, humidity);
  // value = (int)correctedPPM + "," + (int)analogdata2 + "," +(String)temperature+ "," +(String)humidity;
  BTSerial.print((float)correctedPPM);
  BTSerial.print("|");

  BTSerial.print((int)analogdata2);
  BTSerial.print("|");

  BTSerial.print((float)temperature);
  BTSerial.print("|");

  BTSerial.print((float)humidity);
  BTSerial.print("|");
  display.setTextColor(BLACK);
  display.setCursor(0, 0);
  display.setFont();
  display.print("AQI");



  display.setTextColor(RED);
  display.setCursor(0, 25);
  display.setFont(&FreeSerif9pt7b);
  display.print("PM2.5:");
  display.setCursor(70, 30);
  if (analogdata2 > Pmthreshold) {
    display.setCursor(70, 30);
    display.setFont(&FreeSerif9pt7b);
    display.print("DANGER");
    display.setFont();
    display.print(" ");
    digitalWrite(BUZZER, HIGH);
    delay(100);

  } else {
    display.setCursor(70, 30);
    display.print(analogdata2);
    display.setFont();
    display.print(" ppm");
    digitalWrite(BUZZER, LOW);


    // display.fillRect(45,20,50, 15,MAGENTA);
  }
  display.setTextColor(YELLOW);
  display.setCursor(0, 55);
  display.setFont(&FreeSerif9pt7b);
  display.print("Co2:");
  display.setCursor(70, 60);
  if (correctedPPM > COthreshold) {
    display.setCursor(70, 60);
    display.setFont(&FreeSerif9pt7b);
    display.print("DANGER");
    display.setFont();
    display.print(" ");
    digitalWrite(BUZZER, HIGH);
    delay(100);
  } else {


    display.print(correctedPPM);
    display.setFont();
    display.print(" ppm");
    digitalWrite(BUZZER, LOW);
  }
  display.setTextColor(GREEN);
  display.setCursor(0, 85);
  display.setFont(&FreeSerif9pt7b);
  display.print("temp:");
  display.setCursor(70, 90);
  display.print(temperature);
  display.setFont();

  display.print(" C");

  display.setTextColor(GREEN);
  display.setCursor(0, 115);
  display.setFont(&FreeSerif9pt7b);
  display.print("humidity:");
  display.setCursor(70, 120);
  display.print(humidity);
  display.setFont();
  display.print(" %");

  // display.setCursor(10, 15);
  // display.print("PM2.5:");
  // display.println(analogdata2);
  // display.setCursor(10, 30);
  // display.print("temp:");
  // display.println(temperature);
  // display.setCursor(5, 45);
  // display.print("humidity:");
  // display.println(humidity);
  // display.display();
  //mySerial.println(value);
  // Keep reading from HC-05 and send to Arduino Serial Monitor
  if (BTSerial.available()) {
    rawdata = BTSerial.readString();
    Pmindex = rawdata.lastIndexOf('P');
    if (Pmindex > 0) {
      rawdata.remove(Pmindex);
      Serial.print("PM2.5 : ");
      Pmthreshold = rawdata.toFloat();
      Serial.println(Pmthreshold);
    }
    COindex = rawdata.lastIndexOf('O');
    if (COindex > 0) {
      rawdata.remove(COindex);
      Serial.print("Co2 : ");
      COthreshold = rawdata.toFloat();
      Serial.println(COthreshold);
    }
    EEPROM.put(0, Pmthreshold);
    EEPROM.put(20, COthreshold);
  }
  delay(1000);
}
